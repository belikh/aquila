## firmware/esp32-s3-csi-node/components/node_ota/Kconfig
```kconfig
menu "Aquila firmware OTA"

    config AQUILA_OTA_HEALTH_WINDOW_S
        int "Pending-verify health window (seconds)"
        default 60
        range 1 3600
        help
            After an OTA image activates, the node must stay healthy
            (associated, streaming CSI, control responsive) for this many
            seconds before it calls esp_ota_mark_app_valid_cancel_rollback().
            If it does not confirm, the bootloader rolls back to the previous
            image (docs/spec/firmware-ota.md §6).

    config AQUILA_FW_SECURITY_VERSION
        int "Compiled-in firmware security-version floor"
        default 0
        range 0 2147483647
        help
            The anti-rollback floor this build enforces. The effective floor is
            the greater of this value and the monotonic value persisted in NVS
            after a successful update; an OTA image whose version encodes a
            lower security version is rejected (firmware-ota.md §4).

    config AQUILA_FW_ALLOW_DOWNGRADE
        bool "Allow a factory-authorised downgrade below the floor"
        default n
        help
            The explicit factory-authorised force flag of firmware-ota.md §4.
            When disabled (the default), the node rejects any image below the
            security-version floor.

    config AQUILA_FW_PUBKEY_HEX
        string "Compiled-in Ed25519 firmware public key (64 hex characters)"
        default ""
        help
            The 32-byte Ed25519 trust anchor, as 64 hex characters. A key
            provisioned in NVS under the `ota` namespace, key `fw_pubkey`,
            takes precedence. When neither is set the node has no trust anchor
            and fails every OTA verification closed.

endmenu
```

## firmware/esp32-s3-csi-node/main/Kconfig.projbuild
```kconfig
menu "Aquila CSI node"

    # Every option below is a factory default only. The node loads its real
    # provisioning (SSID, password, core host/ports, node id, pairing code) from
    # NVS first; these values are used only when the corresponding NVS key is
    # absent (capture-and-firmware.md §8.3, §9.1.8, §9.3).

    config AQUILA_WIFI_SSID
        string "WiFi SSID (factory default)"
        default "aquila-home"
        help
            The network the node associates with. An ESP-IDF association
            detail; it confers no Aquila role (capture-and-firmware.md §9.1).
            This is only a factory default: the operator-provisioned value in
            NVS (`aquila-capture provision`) overrides it, and it is never the
            only source (G13).

    config AQUILA_WIFI_PASSWORD
        string "WiFi password (factory default)"
        default ""
        help
            The network password; empty for an open network. A factory default
            only: provision the real credential into NVS at flash time so it is
            not baked into a distributed image (G13, F1/F23).

    config AQUILA_CORE_HOST
        string "Core IPv4 address"
        default "192.168.1.10"
        help
            The add-on's IPv4 literal. The node talks only to this endpoint.

    config AQUILA_CORE_DATA_PORT
        int "CSI data-plane UDP port"
        default 9100
        help
            The AQCI data plane port (capture-and-firmware.md §5).

    config AQUILA_CORE_CONTROL_PORT
        int "Node control-plane UDP port"
        default 9101
        help
            The AQCC control plane port (capture-and-firmware.md §6).

    config AQUILA_NODE_ID
        int "Dense node id"
        default 1
        range 1 65535
        help
            The dense on-air node id, provisioned by the operator.

    config AQUILA_PAIRING_CODE
        int "Pairing code"
        default 0
        help
            The short-lived pairing code shown by the core's pairing flow
            (capture-and-firmware.md §6.3); 0 disables join attempts.

endmenu
```
